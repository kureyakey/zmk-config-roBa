## config/west.yml
```yaml
manifest:
  remotes:
    - name: cormoran
      url-base: https://github.com/cormoran
    # 既存のリモートはそのまま維持
  projects:
    # ZMK: DYA Studio 用カスタム RPC サブシステム付き cormoran fork
    - name: zmk
      remote: cormoran
      revision: v0.3-branch+dya
      import: app/west.yml

    - name: zmk-pmw3610-driver
      remote: cormoran
      revision: zmk-v0.3.0.0

    # DYA Studio モジュール（すべて cormoran リポジトリ）
    - name: zmk-module-ble-management
      remote: cormoran
      revision: zmk-v0.3.0.0
    - name: zmk-module-battery-history
      remote: cormoran
      revision: zmk-v0.3.0.0
    - name: zmk-module-settings-rpc
      remote: cormoran
      revision: zmk-v0.3.0.0
    - name: zmk-module-runtime-input-processor
      remote: cormoran
      revision: zmk-v0.3.0.0
  self:
    path: config
```
